## configs/cameras/gv_t31l_sc200ai_atbm6132cu/gv_t31l_sc200ai_atbm6132cu_defconfig
```kconfig
# NAME: Litokam F1.0 / GV-T31-W3 (T31L, SC200AI, ATBM6132CU)
# FRAG: soc-xburst1 core
BR2_INGENIC_SOC_MODEL="t31l"
BR2_ISP_CH0_PRE_DEQUEUE_TIME=y
BR2_ISP_CH0_PRE_DEQUEUE_TIME_VALUE=20
BR2_PACKAGE_THINGINO_KOPT_MMC0=y
BR2_PACKAGE_THINGINO_KOPT_MMC0_PB_4BIT=y
BR2_PACKAGE_WIFI=y
BR2_PACKAGE_WIFI_ATBM6132CU=y
BR2_SENSOR_1_NAME="sc200ai"
BR2_SENSOR_1_PARAMS="shvflip=1"
BR2_THINGINO_AUDIO=y
BR2_THINGINO_BUTTON=y
BR2_THINGINO_DFU=y
BR2_THINGINO_LED_R_GPIO=8
BR2_THINGINO_LED_B_GPIO=9
BR2_THINGINO_RMEM_MB=22
BR2_THINGINO_SDCARD=y
FLASH_SIZE_MB=8
```
